#include "DHT.h"
#include <Wire.h>
#include <Adafruit_GFX.h>
#include <Adafruit_SSD1306.h>
#define OLED_RESET -1
#include <Adafruit_NeoPixel.h>
#define NUMSLEDs 2
#define PINSLEDs 10
Adafruit_NeoPixel SLEDs=Adafruit_NeoPixel(NUMSLEDs,PINSLEDs,NEO_RGB + NEO_KHZ800);
Adafruit_SSD1306 OLED(OLED_RESET);
#define DHTTYPE DHT22
#define DHTPIN D4
#define ledPin1 D0 
#define ledPin2 D7
#define ledPin3 D5
#define sw1 D6
#define sw2 D3
DHT dht (DHTPIN,DHTTYPE,15);
const int buzzer = D8;
int st_sw1 = 0;
int st_sw2 = 0;
int st_1 = 0;
int st_2 = 0;
int last_st_sw1 = 1;
int last_st_sw2 = 1;

const unsigned char Logo_bmp [] = 
{
  0x00, 0x00, 0x00, 0x00, 0x00, 0x00, 0x00, 0x00, 0x00, 0x00, 0x00, 0x00, 0x00, 0x00, 0x00, 0x00,
  0x00, 0x00, 0x00, 0x00, 0x00, 0x00, 0x00, 0x01, 0xFC, 0x00, 0x00, 0x00, 0x00, 0x00, 0x00, 0x00,
  0x00, 0x00, 0x00, 0x00, 0x00, 0x00, 0x00, 0x02, 0x02, 0x00, 0x00, 0x00, 0x00, 0x00, 0x00, 0x00,
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  0x00, 0x00, 0x00, 0x00, 0x00, 0x00, 0x00, 0x00, 0x00, 0x00, 0x00, 0x00, 0x00, 0x00, 0x00, 0x00
};
 const unsigned char Weed [] = {
0x00, 0x00, 0x00, 0x00, 0x00, 0x00, 0x00, 0x00, 0x00, 0x00, 0x00, 0x00, 0x00, 0x00, 0x00, 0x00,
0x00, 0x00, 0x00, 0x00, 0x00, 0x00, 0x00, 0x00, 0x00, 0x00, 0x00, 0x00, 0x00, 0x00, 0x00, 0x00,
0x00, 0x00, 0x00, 0x00, 0x00, 0x00, 0x00, 0x00, 0x00, 0x00, 0x00, 0x00, 0x00, 0x00, 0x00, 0x00,
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0x00, 0x00, 0x00, 0x00, 0x00, 0x00, 0x00, 0x00, 0x00, 0x00, 0x00, 0x00, 0x00, 0x00, 0x00, 0x00
};
void setup() 
{
   pinMode(PINSLEDs,OUTPUT);
   SLEDs.begin();
   SLEDs.show();
   Serial.begin(115200); 
   OLED.begin(SSD1306_SWITCHCAPVCC,0x3c);
   pinMode(buzzer, OUTPUT);
  pinMode(ledPin1, OUTPUT);
  pinMode(ledPin2, OUTPUT);
  pinMode(ledPin3, OUTPUT); 
}
void loop() 
  {
   float h = dht.readHumidity();
   float t = dht.readTemperature();
   float f = dht.readTemperature(true);
   Serial.println(t);
    OLED.clearDisplay();
    OLED.setTextColor(WHITE);
    OLED.setCursor(0,0);
    OLED.setTextSize(2);
    OLED.println(h);
    OLED.setCursor(0,30);
    OLED.println(t);
    OLED.display();
    
   if (t>30) 
   {
    digitalWrite(ledPin1, 1); 
    digitalWrite(ledPin2, 0);
    digitalWrite(ledPin3, 0);
    SLEDs.setPixelColor(0,SLEDs.Color(0,  250,  0));
    SLEDs.setPixelColor(1,SLEDs.Color(0,  250,  0));
    SLEDs.show();
    tone(buzzer,350);
   }
  else  if ((t<30)&&(t>27)) 
   {
    digitalWrite(ledPin1, 0); 
    digitalWrite(ledPin2, 1);
    digitalWrite(ledPin3, 0);
    SLEDs.setPixelColor(0,SLEDs.Color(0,  0,  0));
    SLEDs.setPixelColor(1,SLEDs.Color(0,  0,  0));
    SLEDs.show();
    tone(buzzer, 0);
   }
   else if(t<27)
   {
    digitalWrite(ledPin1, 0); 
    digitalWrite(ledPin2, 0);
    digitalWrite(ledPin3, 1);
    SLEDs.setPixelColor(0,SLEDs.Color(0,  0,  250));
    SLEDs.setPixelColor(1,SLEDs.Color(0,  0,  250));
    SLEDs.show();
    tone(buzzer, 0);
   }
   st_sw1 = digitalRead(sw1);              
   if ((st_sw1 == 0) && (last_st_sw1 == 1)) 
  {
    st_1 = ~st_1;                           
      OLED.clearDisplay();
      OLED.drawBitmap(5,0,Logo_bmp,128,64,1);
      OLED.display();
      delay(1000);
  }
  st_sw2 = digitalRead(sw2);  
   if ((st_sw2 == 0) && (last_st_sw2 == 1))
  {
    st_2 = ~st_2;                          
    OLED.clearDisplay();
    OLED.drawBitmap(5,0,Weed,128,64,1);
    OLED.display();        
    delay(1000);
  }
  }

   
